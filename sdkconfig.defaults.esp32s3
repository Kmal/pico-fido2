## sdkconfig.defaults.esp32s3
```kconfig
# Common ESP32-S3 settings for M5Stack Cardputer-Adv and StickS3 builds.
CONFIG_IDF_TARGET="esp32s3"
CONFIG_IDF_TARGET_ESP32S3=y
CONFIG_ESP_DEFAULT_CPU_FREQ_MHZ_240=y
# CONFIG_ESPTOOLPY_FLASHSIZE_4MB is not set
CONFIG_ESPTOOLPY_FLASHSIZE_8MB=y
CONFIG_ESPTOOLPY_FLASHMODE_QIO=y
CONFIG_TINYUSB_TASK_STACK_SIZE=16384
CONFIG_USB_OTG_SUPPORTED=y
CONFIG_PARTITION_TABLE_CUSTOM=y
CONFIG_PARTITION_TABLE_CUSTOM_FILENAME="partitions_esp32s3_8mb.csv"
CONFIG_PARTITION_TABLE_FILENAME="partitions_esp32s3_8mb.csv"
```

## sdkconfig.defaults.m5stack_cardputer_adv
```kconfig
# M5Stack Cardputer-Adv: ESP32-S3FN8, 8 MB flash, no PSRAM.
# CONFIG_PICO_FIDO2_M5_DISPLAY_STATUS is not set
# CONFIG_ESPTOOLPY_FLASHSIZE_4MB is not set
CONFIG_ESPTOOLPY_FLASHSIZE_8MB=y
# CONFIG_SPIRAM is not set
```

## sdkconfig.defaults.m5stack_stick_s3
```kconfig
# M5Stack StickS3: ESP32-S3-PICO-1-N8R8, 8 MB flash, 8 MB PSRAM.
# CONFIG_PICO_FIDO2_M5_DISPLAY_STATUS is not set
# CONFIG_ESPTOOLPY_FLASHSIZE_4MB is not set
CONFIG_ESPTOOLPY_FLASHSIZE_8MB=y
CONFIG_SPIRAM=y
CONFIG_SPIRAM_MODE_OCT=y
CONFIG_SPIRAM_SPEED_80M=y
CONFIG_SPIRAM_USE_MALLOC=y
```

## src/m5boards/Kconfig
```kconfig
menu "Pico FIDO2 M5Stack boards"

config PICO_FIDO2_M5_DISPLAY_STATUS
    bool "Show authenticator status on M5Stack LCD"
    default n

endmenu
```
